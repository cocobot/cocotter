## code/sdkconfig.defaults
```kconfig
# Flash size 8MB (ESP32-S3-WROOM-1-N8R8)
CONFIG_ESPTOOLPY_FLASHSIZE_8MB=y
CONFIG_ESPTOOLPY_HEADER_FLASHSIZE_UPDATE=y

# Custom partition table with OTA
CONFIG_PARTITION_TABLE_CUSTOM=y
CONFIG_PARTITION_TABLE_CUSTOM_FILENAME="partitions.csv"

# Rust often needs a bit of an extra main task stack size compared to C (the default is 3K)
CONFIG_ESP_MAIN_TASK_STACK_SIZE=20000
CONFIG_PTHREAD_TASK_STACK_SIZE_DEFAULT=8192

# Use this to set FreeRTOS kernel tick frequency to 1000 Hz (100 Hz by default).
# This allows to use 1 ms granularity for thread sleeps (10 ms by default).
CONFIG_FREERTOS_HZ=1000

# Enable NVS Flash (required for BT)
CONFIG_NVS_FLASH=y

# Bluetooth configuration - NimBLE
CONFIG_BT_ENABLED=y
CONFIG_BT_NIMBLE_ENABLED=y
CONFIG_BT_BLUEDROID_ENABLED=n
CONFIG_BT_CLASSIC_ENABLED=n

# BLE 5.0 extended advertising support
CONFIG_BT_NIMBLE_50_FEATURE_SUPPORT=y
CONFIG_BT_NIMBLE_EXT_ADV=y
CONFIG_BT_NIMBLE_MAX_EXT_ADV_INSTANCES=1

# Max ATT MTU for OTA throughput
CONFIG_BT_NIMBLE_ATT_PREFERRED_MTU=512

# Data Length Extension (DLE) for larger link-layer packets
CONFIG_BT_NIMBLE_LL_CFG_FEAT_DATA_LEN_EXT=y
```
